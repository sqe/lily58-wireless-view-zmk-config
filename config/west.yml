## config/west.yml
```yaml
manifest:
  remotes:
    - name: zmkfirmware
      url-base: https://github.com/zmkfirmware
    # support nice_oled and nice_epaper
    - name: mctechnology17
      url-base: https://github.com/mctechnology17
    - name: gpeye                         
      url-base: https://github.com/GPeye  
  projects:
    - name: zmk
      remote: zmkfirmware
      revision: main
      import: app/west.yml
    # support nice_oled and nice_epaper
    - name: zmk-nice-oled
      remote: mctechnology17
      revision: main
    - name: hammerbeam-slideshow          #new entry
      remote: gpeye                       #new entry
      revision: main  
      
  self:
    path: config
```
